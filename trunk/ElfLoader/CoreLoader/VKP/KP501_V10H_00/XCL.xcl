-carm
-Z(CODE)PATCH_JVMHOOK=465D18DC-FFFFFFFF
-Z(CODE)PATCH_INITHOOK=46594A50-FFFFFFFF
-Z(CODE)START,CODE,SWITAB,INITTAB,DATA_ID,DATA_C=46B61700-FFFFFFFF
-Z(DATA)DATA_N,DATA_I,DATA_Z=40500000-FFFFFFFF







